## zmk/config/boards/shields/josuke/Kconfig.defconfig
```kconfig
if SHIELD_JOSUKEY_LEFT

config ZMK_KEYBOARD_NAME
    default "Josukey"

config ZMK_SPLIT_ROLE_CENTRAL
    default y

endif

if SHIELD_JOSUKEY_LEFT || SHIELD_JOSUKEY_RIGHT

config ZMK_SPLIT
    default y

endif
```

## zmk/config/boards/shields/josukey/Kconfig.shield
```kconfig
config SHIELD_JOSUKEY_LEFT
    def_bool $(shields_list_contains,josukey_left)

config SHIELD_JOSUKEY_RIGHT
    def_bool $(shields_list_contains,josukey_right)
```
